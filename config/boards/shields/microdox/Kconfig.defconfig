## config/boards/shields/microdox/Kconfig.defconfig
```kconfig
# Copyright (c) 2020 The ZMK Contributors
# SPDX-License-Identifier: MIT

if SHIELD_MICRODOX_V2_DONGLE

config ZMK_KEYBOARD_NAME
    default "Microdox"

config ZMK_SPLIT_ROLE_CENTRAL
    default y

config ZMK_USB
    default y

endif

if SHIELD_MICRODOX_V2_LEFT || SHIELD_MICRODOX_V2_RIGHT

if LVGL

config LV_Z_VDB_SIZE
	default 64

config LV_DPI_DEF
	default 148

config LV_Z_BITS_PER_PIXEL
	default 1

choice LV_COLOR_DEPTH
	default LV_COLOR_DEPTH_1
endchoice

endif # LVGL

endif

if SHIELD_SKELETYL_LEFT || SHIELD_SKELETYL_RIGHT || SHIELD_SKELETYL_DONGLE

config ZMK_SPLIT
	default y

config ZMK_BLE
    default y

endif
```

## config/boards/shields/microdox/Kconfig.shield
```kconfig
config SHIELD_MICRODOX_V2_LEFT
    def_bool $(shields_list_contains,microdox_v2_left)

config SHIELD_MICRODOX_V2_RIGHT
    def_bool $(shields_list_contains,microdox_v2_right)

config SHIELD_microdox_DONGLE
    def_bool $(shields_list_contains,microdox_dongle)
```
